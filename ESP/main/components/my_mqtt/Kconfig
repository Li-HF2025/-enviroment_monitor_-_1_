## ESP/main/components/my_mqtt/Kconfig
```kconfig
menu "My MQTT Configuration"
    config BROKER_URL
        string "MQTT Broker URL"
        default ""
        help
            必填：MQTT Broker地址，必须包含协议头。
            示例（非TLS）：mqtt://mqtts.heclouds.com:1883
            示例（TLS）：mqtts://mqttstls.heclouds.com:8883

    config ONENET_PRODUCT_ID
        string "ONENET Product ID"
        default ""
        help
            必填：ONENET产品ID。请在平台产品详情中获取。

    config ONENET_DEVICE_NAME
        string "ONENET Device Name"
        default ""
        help
            必填：ONENET设备名称。请与平台创建设备时保持一致。

    config ONENET_TOKEN
        string "ONENET Token"
        default ""
        help
            必填：使用设备key按ONENET规则计算得到的token。

    config ONENET_HEARTBEAT_PAYLOAD
        string "ONENET First Heartbeat Payload"
        default ""
        help
            选填：连接成功后自动上报到dp/post/json的首条payload。
            留空则仅自动订阅命令主题，不发送首条上报。
endmenu
```

## ESP/main/components/my_ota/Kconfig
```kconfig
menu "OTA Configuration"
    config OTA_ENABLE
        bool "Enable OTA"
        default y
        help
            是否启用OTA功能。启用后，设备将自动进行OTA升级。
    config OTA_URL
        string "OTA Server URL"
        default ""
        help 
            OTA服务器URL，必须包含协议头。
    
endmenu
```

## ESP/main/components/my_screen/Kconfig
```kconfig
menu "MY_SCREEN Configuration"
    config LCD_TOUCH_ENABLED
        int "Enable LCD Touch"
        default 0
        help
            选项：是否启用LCD触摸功能。
            启用后需要正确配置触摸屏相关参数，并在代码中实现触摸事件处理逻辑。

    config LCD_MIRROR_Y
        int  "Mirror LCD Display Vertically"
        default 0
        help
            选项：是否垂直镜像LCD显示。
            启用后，LCD显示内容将被垂直翻转。
endmenu
```

## ESP/main/components/my_wifi/Kconfig
```kconfig
menu "My WiFi Configuration"

    config MY_WIFI_SSID
        string "Wi-Fi SSID"
        default "Xiaomi"
        help
            Wi-Fi SSID to connect to.

    config MY_WIFI_PASSWORD
        string "Wi-Fi Password"
        default "258790TLYlhy"
        help
            Wi-Fi password to connect with.

    config MY_WIFI_MAXIMUM_RETRY
        int "Maximum Wi-Fi connection retry"
        default 5
        help
            Maximum number of times to retry connecting to the Wi-Fi network.

endmenu
```

## ESP/sdkconfig.defaults
```kconfig
CONFIG_BLINK_LED_GPIO=y
CONFIG_BLINK_GPIO=8
CONFIG_BOOTLOADER_APP_ROLLBACK_ENABLE=y
CONFIG_BOOTLOADER_APP_ANTI_ROLLBACK=n
```
